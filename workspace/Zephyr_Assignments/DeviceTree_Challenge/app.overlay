/ {
    aliases {
        led0 = &user_led;
    };

    leds {
        compatible = "gpio-leds";
        user_led: led_0 {
            gpios = <&gpioa 0 GPIO_ACTIVE_HIGH>;
            label = "User LED";
        };
    };
};

